## kernel/experimental-lenovo-fan-wmi/Kconfig
```kconfig
# This fragment is intentionally not included by any kernel tree or by this
# repository's build files. It documents the opt-in configuration a future,
# separately reviewed integration would require.

config LEGION_LINUX_EXPERIMENTAL_FAN_WMI
	tristate "LegionLinuxToolkit experimental Lenovo fan WMI reader"
	depends on ACPI_WMI
	default n
	help
	  Build the experimental Lenovo fan WMI module with passive device binding.
	  It cannot evaluate a WMI method unless the separate real-read option is
	  explicitly enabled.

	  This option must remain disabled unless a separately reviewed phase
	  explicitly authorizes both a kernel integration and a one-shot read-only
	  Fan_Get_Table experiment for the documented machine and BIOS.

config LEGION_LINUX_EXPERIMENTAL_FAN_FULL_SPEED_READ
	bool "Explicit one-shot GetFeatureValue FanFullSpeed observation"
	depends on LEGION_LINUX_EXPERIMENTAL_FAN_WMI && ACPI_WMI
	default n
	help
	  Adds only a fixed MethodId 17 query, gated by runtime confirmation.
	  Never invokes firmware during init/probe/remove. Does not force binding
	  to devices owned by another driver. No setters or curve activation.

config LEGION_LINUX_EXPERIMENTAL_FAN_WMI_CONTROL_STAGING
	bool "Compile inaccessible default-curve transport staging"
	depends on LEGION_LINUX_EXPERIMENTAL_FAN_WMI && ACPI_WMI
	default n
	help
	  Compile MethodId 6 staging with a constant false execution barrier.
	  No endpoint or runtime switch exists. No firmware method is invoked.

config LEGION_LINUX_EXPERIMENTAL_FAN_WMI_REAL_READ
	bool "Enable the experimental Lenovo fan WMI read path"
	depends on LEGION_LINUX_EXPERIMENTAL_FAN_WMI && ACPI_WMI
	default n
	help
	  Compile the endpoint-triggered Fan_Get_Table read path. It is disabled by
	  default and must not be enabled without a separately reviewed, explicit
	  authorization for one read-only firmware call on the documented machine.

	  This option does not add fan writes or Fan_Set_Table support.
```
